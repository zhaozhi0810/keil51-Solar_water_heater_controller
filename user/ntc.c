#include "ntc.h"
#include "adc.h"

#define ARRAY_SIZE(a) (sizeof(a)/sizeof(a[0]))

//unsigned int NTC_R;//定义热敏电阻阻值变量
//unsigned char temperature;//定义温度存储变量

#if 0
unsigned int code Ttable[]={//温度与电阻阻值对应关系表格
3274,//0度对应阻值32.74k
3111,//1度对应阻值31.11k
2957,//2度对应阻值29.57k
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59,
58//105度对应阻值0.58k
};	


uint16 code ntc10k_tab[] = {
2801, /* 0 */ 
2682, /* 1 */ 
2569, /* 2 */ 
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 78, /* 105 */ 

};

#endif

//2022-04-03 调整，温度有点差值，向后调整两个数2022-04-03
uint16 code ntc10k_tab[] = {
//841, /* 0 */ 
//833, /* 1 */ 
830, /* 2 */ 
823, /* 3 */ 
816, /* 4 */ 
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305, /* 99 */
303 /* 99 */
};



static int8 NTC_bSearch(uint16 *tab, uint8 tab_size, int16 val)
{
    uint8 mid	= 0; 
    uint8 left	= 0; 
	uint8 right	= tab_size - 1;
//	char t1,t2,t3;

	if(val > tab[0]) return -1; // 温度下限
	else if(val < tab[tab_size - 1]) return -2; // 温度上限

    while(left <= right)
	{ 
        mid = (right + left) / 2;
        if(val == tab[mid])
            return mid;
        else if (val > tab[mid])
            right = mid - 1;
        else if (val < tab[mid])
            left = mid + 1;
	}

	//这里正好没有取到对应值
	if(val > tab[mid])  //向左边看看
	{	
		right = val - tab[mid] ;
		left = tab[mid-1] - val;    //左边的值肯定更大
		if(left<right)            //与左边的差值更小
			mid --;   //向左边取一个
	}
	else 
	{	
		left = tab[mid] - val;
		right = val -  tab[mid+1] ;    //右边的值肯定更小
		if(left>right)            //与右边的差值更小
			mid ++;   //向左边取一个
	}
	
	
    return mid;
}


char T_dis(unsigned int t_val){//温度处理函数采集到的阻值与二维数组的阻值进行比较，从而获得相对应的温度值。

	//return NTC_bSearch(Ttable, sizeof(Ttable)/sizeof(Ttable[0]), t_val);
	return NTC_bSearch(ntc10k_tab, sizeof(ntc10k_tab)/sizeof(ntc10k_tab[0]), t_val);
}

