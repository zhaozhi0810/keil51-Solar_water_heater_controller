#include "1302.h"
#include "stdio.h"


//DS1302端口定义
sbit TSCLK = P2^2; //时钟
sbit TIO = P2^1;   //数据
sbit TRST = P2^0;  //使能

#define DS1302_W_ADDR 0x80  //写时钟日历寄存器起始地址
#define DS1302_R_ADDR 0x81	//读时钟日历寄存器起始地址
#define uchar unsigned char
#define uint unsigned int


//时钟日历暂存数组，秒、分、时、日、月、周、年 初值为= 22年9月15日 周四 23:59:00
uchar TimeData[7]={00, 59, 23, 15, 9, 4, 22};


void ds1302_io_set_input(void)
{
	P2M1 |= 0x2;  //P2.1 设置为输入
	P2M0 &= ~0x2;   
}

void ds1302_io_set_output(void)
{
	P2M0 |= 0x2;  //P2.1 设置为推挽输出
	P2M1 &= ~0x2;  
}



/*=================================================
*函数名称：DS1302_W_Byte
*函数功能：DS1302写一字节数据
*输入：dat：要写入的数据
=================================================*/
void DS1302_W_Byte(uchar dat)
{
	uchar i;
	ds1302_io_set_output();
	for(i = 0; i < 8; i++) //每次写1bit，写8次
	{
		TSCLK = 0;		   //拉低时钟总线
		TIO = dat & 0x01;  //从一字节最低位开始写
		TSCLK = 1;		   //拉高时钟总线，DS1302把数据读走
		dat >>= 1;		   //数据右移一位 
	}	
}
/*=================================================
*函数名称：DS1302_R_Byte
*函数功能：DS1302读一字节
*输出：dat：读取的数据
=================================================*/
uchar DS1302_R_Byte()
{
	uchar i, dat;
	ds1302_io_set_input();
	for(i = 0; i < 8; i++)  //每次写1bit，写8次
	{
		TSCLK = 0;			//拉低时钟总线，DS1302把数据放到数据总线上
		dat >>= 1; 			//数据右移一位，数据从最低位开始读 
		if(TIO)	dat |= 0x80;//读取数据
		TSCLK = 1;			//拉高时钟总线
	}
	return dat;				//返回读取的数据
}
/*=================================================
*函数名称：DS1302_W_DAT
*函数功能：写DS1302数据一次写2个字节
*说明：先写命令后写数据
*调用：DS1302_W_Byte()
*输入：cmd：需要写的命令 ，dat：需要些的数据
=================================================*/
void DS1302_W_DAT(uchar cmd, uchar dat)
{
	TRST = 0;			 //拉低使能端
	TSCLK = 0;			 //拉低数据总线
	TRST = 1;			 //拉高使能端，开始写数据
	DS1302_W_Byte(cmd);	 //写命令
	DS1302_W_Byte(dat);	 //写数据
}
/*=================================================
*函数名称：DS1302_R_DAT
*函数功能：读DS1302数据
*说明：先写入命令字节后读出对应数据
*调用：	DS1302_W_Byte();DS1302_R_Byte();
*输入：	cmd：需要写的命令
*输出：	dat：读出的数据
=================================================*/
uchar DS1302_R_DAT(uchar cmd)
{
	uchar dat;
	TRST = 0;			 	//拉低使能端
	TSCLK = 0;				//拉低数据总线
	TRST = 1;				//拉高使能端，开始写数据
	DS1302_W_Byte(cmd);		//写命令
	dat = DS1302_R_Byte();	//读出数据
	return dat;				//返回读出数据
}

/*=================================================
*函数名称：DS1302_Clear_WP
*函数功能：清除DS1302写保护
*说明：先写入命令0x8e（写控制寄存器）接着向该寄存器写0
*调用：DS1302_W_DAT()
=================================================*/
void DS1302_Clear_WP()
{
	DS1302_W_DAT(0x8e,0x00);  //把控制寄存器WP位置0
}
/*=================================================
*函数名称：DS1302_Clear_WP
*函数功能：设置DS1302写保护
*说明：先写入命令0x8e（写控制寄存器）接着向该寄存器写0x80
*调用：DS1302_W_DAT()
=================================================*/
void DS1302_Set_WP()
{	
	DS1302_W_DAT(0x8e,0x80); //把控制寄存器WP位置1
	TRST = 0;				 //拉低使能端
	TSCLK = 0;				 //拉低数据总线
} 
/*=================================================
*函数名称：Set_DS1302_Time
*函数功能：设置DS1302时钟日历数据
*说明：把时钟日历暂存数组TimeData数据转换为BCD码并
	   写入到DS1302时钟日历寄存器中
*调用：DS1302_Clear_WP();DS1302_W_DAT();DS1302_Set_WP();
*输入：addr:需要写入寄存器的地址 ，TimeData数组：时钟日历初始值
注意：：要求输入值是16进制表示，比如0x12，表示12分等类似。
=================================================*/
void Set_DS1302_Time(unsigned char hour,unsigned char min,unsigned char sec)
{
//	uchar t;
	uchar addr = DS1302_W_ADDR;
	DS1302_Clear_WP();		//清除写保护
	
//	t = sec %10;    //要求输入值是16进制表示，比如0x12，表示12分等类似。
//	t = (sec /10 << 4) + t;
	DS1302_W_DAT(addr, sec); //先写DS1302时钟日历起始地址，再写数据
	addr += 2;	 //时钟日历寄存器地址+2转向下一个寄存器
	
	DS1302_W_DAT(addr, min); //先写DS1302时钟日历起始地址，再写数据
	addr += 2;	 //时钟日历寄存器地址+2转向下一个寄存器
	
	DS1302_W_DAT(addr, hour); //先写DS1302时钟日历起始地址，再写数据
	addr += 2;	 //时钟日历寄存器地址+2转向下一个寄存器
	
//	for(i = 0; i < 7; i++)	//写入7个字节的时钟初始值
//	{
//		j = TimeData[i]/10;	 //BCD码转换
//		TimeData[i] %= 10;	 //BCD码转换
//		TimeData[i] += j*16; //BCD码转换
//		DS1302_W_DAT(addr, TimeData[i]); //先写DS1302时钟日历起始地址，再写数据
//		addr += 2;	 //时钟日历寄存器地址+2转向下一个寄存器
//	}
	DS1302_Set_WP(); //开起写保护		
}
/*=================================================
*函数名称：Read_DS1302_Time
*函数功能：读取DS1302时钟数据
*说明：	读取DS1302时钟数据 返回数据存入时钟日历暂存
		数组TimeData（数据格式BCD码）
*调用：DS1302_Clear_WP();DS1302_R_DAT();DS1302_Set_WP();
*输入：	addr：需要读取时钟日历寄存器的起始地址
=================================================*/
void Ds1302readTime()
{
	uchar i;
	uchar addr = DS1302_R_ADDR;
//	int a=12,b=23,c=6;
	DS1302_Clear_WP();    	//清楚些保护
	for(i = 0; i < 3; i++)	//从DS1302读取7个字节的时钟日历数据
	{
		TimeData[i] = DS1302_R_DAT(addr);//先写入要读取数据的寄存器起始地址，再读出数据存入TimeData数组
		addr += 2;						 //时钟日历寄存器地址+2转向下一个寄存器
	}
	DS1302_Set_WP();   //开起写保护
//	a = TimeData[0];
//	b = TimeData[1];
//	c = TimeData[2];
//	printf("time:%d:%d:%d\r\n",c,b,a);
	
} 

